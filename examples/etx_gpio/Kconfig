## examples/etx_gpio/Kconfig
```kconfig
#
# EmbeTronicX GPIO Example Application Configuration
#

config EXAMPLES_ETX_GPIO
    bool "EmbeTronicX GPIO Example"
    default n
    depends on ARCH_CHIP_ESP32
    help
      Enables the EmbeTronicX GPIO interrupt example for ESP32.

if EXAMPLES_ETX_GPIO

config EXAMPLES_ETX_GPIO_PROGNAME
    string "Program name"
    default "etx_gpio"
    help
      Name of the NSH command or ELF binary that will be installed and run.

config EXAMPLES_ETX_GPIO_PRIORITY
    int "Task priority"
    default 100
    help
      Task priority of the GPIO example app.

config EXAMPLES_ETX_GPIO_STACKSIZE
    int "Stack size"
    default DEFAULT_TASK_STACKSIZE
    help
      Stack size for the GPIO example task.

endif
```

## examples/imu_controller/Kconfig
```kconfig
#
# IMU Example Application Configuration
#

config EXAMPLES_IMU
    bool "IMU Example"
    default n
    ---help---
        IMU example application.

if EXAMPLES_IMU

config EXAMPLES_IMU_PROGNAME
    string "IMU program name"
    default "imu"
    help
        This is the name of the NSH command or ELF binary that will be installed and used to run the IMU reader.

config EXAMPLES_IMU_PRIORITY
	int "IMU task priority"
	default 100
	---help---
		Priority of the IMU measurement task if run as a background thread.

config EXAMPLES_IMU_STACKSIZE
	int "IMU stack size"
	default DEFAULT_TASK_STACKSIZE
	---help---
		Stack size for the IMU measurement task.

menu "IMU Configuration"

config EXAMPLES_IMU_I2C_FD
    string "I2C device file"
    default "/dev/i2c0"
    help
      Path to the I2C device used to communicate with the IMU.

endmenu

endif
```

## examples/loadcell/Kconfig
```kconfig
#
# Load Cell Example Application Configuration
#

config EXAMPLES_LOADCELL
    bool "Load Cell Example"
    default n
    ---help---
        Load Cell example application.

if EXAMPLES_LOADCELL

config EXAMPLES_LOADCELL_PROGNAME
    string "Load Cell program name"
    default "loadcell"
    help
        This is the name of the NSH command or ELF binary that will be installed and used to run the Load Cell reader.


config EXAMPLES_LOADCELL_PRIORITY
	int "Load Cell task priority"
	default 100
	---help---
		Priority of the Load Cell measurement task if run as a background thread.

config EXAMPLES_LOADCELL_STACKSIZE
	int "Load Cell stack size"
	default DEFAULT_TASK_STACKSIZE
	---help---
		Stack size for the Load Cell measurement task.

menu "Loadcell Controller Configuration"

config EXAMPLES_LOADCELL_NUM_CHANNELS
    int "Number of Load Cell Channels"
    default 2
    help
      Sets how many load cells are connected.

config EXAMPLES_LOADCELL_RATED_KG
    int "Rated capacity of load cell (kg)"
    default 100
    help
      Maximum rated weight of each load cell.

config EXAMPLES_LOADCELL_I2C_FD
    string "I2C device file"
    default "/dev/i2c0"
    help
      Path to the I2C device used to communicate with NAU7802.

config EXAMPLES_LOADCELL_MUX_SELECT_PIN_BIT_0
    string "GPIO pin path for mux select bit 0"
    default "/dev/gpio0"
    help
      GPIO file path used for multiplexer select line 0.

config EXAMPLES_LOADCELL_MUX_SELECT_PIN_BIT_1
    string "GPIO pin path for mux select bit 1"
    default "/dev/gpio1"
    help
      GPIO file path used for multiplexer select line 1.

config EXAMPLES_LOADCELL_MUX_SELECT_PIN_BIT_2
    string "GPIO pin path for mux select bit 2"
    default "/dev/gpio2"
    help
      GPIO file path used for multiplexer select line 2.
endmenu

endif
```

## examples/master_controller/Kconfig
```kconfig
#
# Master Controller Example Application Configuration
#

config EXAMPLES_MASTER_CONTROLLER
    bool "Master Controller Example"
    default n
    help
        Master Controller example application.

if EXAMPLES_MASTER_CONTROLLER

config EXAMPLES_MASTER_CONTROLLER_PROGNAME
    string "Master Controller program name"
    default "master_controller"
    help
        This is the name of the NSH command or ELF binary that will be installed and used to run the Master Controller.

config EXAMPLES_MASTER_CONTROLLER_PRIORITY
    int "Master Controller task priority"
    default 100
    help
        Priority of the Master Controller task if run as a background thread.

config EXAMPLES_MASTER_CONTROLLER_STACKSIZE
    int "Master Controller stack size"
    default DEFAULT_TASK_STACKSIZE
    help
        Stack size for the Master Controller task.

endif
```

## examples/optical_encoder/Kconfig
```kconfig
#
# Optical Encoder Example Application Configuration
#

config EXAMPLES_OPTICALENCODER
    bool "Optical Encoder Example"
    default n
    ---help---
        Optical Encoder example application.

if EXAMPLES_OPTICALENCODER

config EXAMPLES_OPTICALENCODER_PROGNAME
    string "Optical Encoder program name"
    default "optical_encoder"
    help
        This is the name of the NSH command or ELF binary that will be installed and used to run the Optical Encoder reader.

config EXAMPLES_OPTICALENCODER_PRIORITY
    int "Optical Encoder task priority"
    default 100
    ---help---
        Priority of the Optical Encoder task if run as a background thread.

config EXAMPLES_OPTICALENCODER_STACKSIZE
    int "Optical Encoder stack size"
    default DEFAULT_TASK_STACKSIZE
    ---help---
        Stack size for the Optical Encoder task.

config EXAMPLES_OPTICALENCODER_GPIOA
    string "GPIO device for encoder channel A"
    default "/dev/gpio4"
    help
        Path to the GPIO device that serves as channel A of the optical encoder.

config EXAMPLES_OPTICALENCODER_GPIOB
    string "GPIO device for encoder channel B"
    default "/dev/gpio3"
    help
        Path to the GPIO device that serves as channel B of the optical encoder.

config EXAMPLES_OPTICALENCODER_PPR
    int "Number of Pulses Per Revolution"
    default 24
    help 
        Number of Pulses per Revolution for one rotation.

config EXAMPLES_OPTICALENCODER_INITIAL_LENGTH_METERS
    int "Initial cable length in meters"
    default 0
    help
        The starting length of the cable wound on the drum, in meters.

config EXAMPLES_OPTICALENCODER_AVERAGE_DRUM_RADIUS_MM
    int "Average drum radius in millimeters"
    default 100
    help
        The average radius of the winch drum in millimeters. Used to calculate linear velocity.

endif
```

## examples/proximity_controller/Kconfig
```kconfig
#
# Proximity Sensor Example Application Configuration
#

config EXAMPLES_PROXIMITYSENSOR
    bool "Proximity Sensor Example"
    default n
    help
        Proximity Sensor example application.

if EXAMPLES_PROXIMITYSENSOR

config EXAMPLES_PROXIMITYSENSOR_PROGNAME
    string "Proximity Sensor program name"
    default "proximity_sensor"
    help
        This is the name of the NSH command or ELF binary that will be installed and used to run the Proximity Sensor application.

config EXAMPLES_PROXIMITYSENSOR_PRIORITY
    int "Proximity Sensor task priority"
    default 100
    help
        Priority of the Proximity Sensor task if run as a background thread.

config EXAMPLES_PROXIMITYSENSOR_STACKSIZE
    int "Proximity Sensor stack size"
    default DEFAULT_TASK_STACKSIZE
    help
        Stack size for the Proximity Sensor task.

menu "Proximity Sensor Config"
    config EXAMPLES_I2C_FD
    string "I2C device file"
    default "/dev/i2c0"
    help
        Path to the I2C device used to communicate with the Proximity Sensor.
endmenu

endif
```

## examples/slave_controller/Kconfig
```kconfig
#
# Slave Controller Example Application Configuration
#

config EXAMPLES_SLAVECONTROLLER
    bool "Slave Controller Example"
    default n
    help
        Slave Controller example application.

if EXAMPLES_SLAVECONTROLLER

config EXAMPLES_SLAVECONTROLLER_PROGNAME
    string "Slave Controller program name"
    default "slave_controller"
    help
        This is the name of the NSH command or ELF binary that will be installed and used to run the Slave Controller.

config EXAMPLES_SLAVECONTROLLER_PRIORITY
    int "Slave Controller task priority"
    default 100
    help
        Priority of the Slave Controller task if run as a background thread.

config EXAMPLES_SLAVECONTROLLER_STACKSIZE
    int "Slave Controller stack size"
    default DEFAULT_TASK_STACKSIZE
    help
        Stack size for the Slave Controller task.

menu "Slave Controller Message Queue Configuration"

config EXAMPLES_SLAVE_CONTROLLER_MQUEUE_IMU_NAME
    string "MQ Name: IMU"
    default "/mq_imu"
    help
        Message queue name for IMU data.

config EXAMPLES_SLAVE_CONTROLLER_MQUEUE_PROXIMITY_SENSOR_NAME
    string "MQ Name: Proximity Sensor"
    default "/mq_proximity"
    help
        Message queue name for proximity sensor data.

config EXAMPLES_SLAVE_CONTROLLER_MQUEUE_TEMPERATURE_SENSOR_NAME
    string "MQ Name: Temperature Sensor"
    default "/mq_temperature"
    help
        Message queue name for temperature sensor data.

endmenu

endif # EXAMPLES_SLAVECONTROLLER
```

## examples/tcp_controller/Kconfig
```kconfig
#
# TCP Controller Example Application Configuration
#

config EXAMPLES_TCP_CONTROLLER
    bool "TCP Controller Example"
    default n
    help
        TCP Controller example application.

if EXAMPLES_TCP_CONTROLLER

config EXAMPLES_TCP_CONTROLLER_PROGNAME
    string "TCP Controller program name"
    default "tcp_controller"
    help
        This is the name of the NSH command or ELF binary that will be installed and used to run the TCP Controller.

config EXAMPLES_TCP_CONTROLLER_PRIORITY
    int "TCP Controller task priority"
    default 100
    help
        Priority of the TCP Controller task if run as a background thread.

config EXAMPLES_TCP_CONTROLLER_STACKSIZE
    int "TCP Controller stack size"
    default DEFAULT_TASK_STACKSIZE
    help
        Stack size for the TCP Controller task.

config EXAMPLES_TCP_CONTROLLER
    bool "TCP Controller Example"
    default n
    help
        Enable the TCP Controller example application.


config EXAMPLES_TCP_CONTROLLER_PORT_NUM
    int "TCP Port Number"
    default 5000
    help
        The TCP port number to be used by the server/client.

config EXAMPLES_TCP_CONTROLLER_SERVER_IP
    string "Server IP Address"
    default "10.0.0.2"
    help
        IP address of the TCP server.

config EXAMPLES_TCP_CONTROLLER_CLIENT_IP
    string "Client IP Address"
    default "10.0.0.3"
    help
        IP address of the TCP client.

config EXAMPLES_TCP_CONTROLLER_IFNAME
    string "Interface Name"
    default "wlan0"
    help
        The name of the network interface to use.

config EXAMPLES_TCP_CONTROLLER_SSID
    string "WiFi SSID"
    default "MyWiFiNetwork"
    help
        SSID for connecting to WiFi.

config EXAMPLES_TCP_CONTROLLER_PASSWORD
    string "WiFi Password"
    default "password123"
    help
        Password for connecting to WiFi.




endif
```

## examples/winch_controller/Kconfig
```kconfig
#
# Winch Controller Application Configuration
#

config EXAMPLES_WINCHCONTROLLER
    bool "Winch Controller Example"
    default n
    help
        Winch Controller example application.

if EXAMPLES_WINCHCONTROLLER

config EXAMPLES_WINCHCONTROLLER_PROGNAME
    string "Winch Controller program name"
    default "winch_controller"
    help
        This is the name of the NSH command or ELF binary that will be installed and used to run the Winch Controller.

config EXAMPLES_WINCHCONTROLLER_PRIORITY
    int "Winch Controller task priority"
    default 100
    help
        Priority of the Winch Controller task if run as a background thread.

config EXAMPLES_WINCHCONTROLLER_STACKSIZE
    int "Winch Controller stack size"
    default DEFAULT_TASK_STACKSIZE
    help
        Stack size for the Winch Controller task.

config EXAMPLES_WINCHCONTROLLER_MQUEUE_NAME
    string "Winch Controller message queue name"
    default "/mqwinch"
    help
        The name of the POSIX message queue used by the Winch Controller.

config EXAMPLES_WINCHCONTROLLER_MAX_REEL_SPEED_PERCENT
    int "Winch Controller maximum speed percent"
    default 100
    help
        Maximum speed the winch is allowed to reel at, expressed as a percentage (0–100).

endif
```
